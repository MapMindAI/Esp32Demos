## IDF_esp32p4_rtsp/main/Kconfig.projbuild
```kconfig
menu "Camera RTSP Configuration"

    config EXAMPLE_MIPI_CSI_SCCB_I2C_PORT
        int "MIPI CSI SCCB I2C Port Number"
        default 0
        range 0 1

    config EXAMPLE_MIPI_CSI_SCCB_I2C_SCL_PIN
        int "MIPI CSI SCCB I2C SCL Pin"
        default 8
        range -1 56

    config EXAMPLE_MIPI_CSI_SCCB_I2C_SDA_PIN
        int "MIPI CSI SCCB I2C SDA Pin"
        default 7
        range -1 56

    config EXAMPLE_MIPI_CSI_SCCB_I2C_FREQ
        int "MIPI CSI SCCB I2C Frequency"
        default 100000
        range 100000 400000
        help
            Increasing this value can reduce the initialization time of the camera sensor.
            Please refer to the relevant instructions of the camera sensor to adjust the value.

    config EXAMPLE_MIPI_CSI_CAM_SENSOR_RESET_PIN
        int "MIPI CSI Camera Sensor Reset Pin"
        default -1
        range -1 56

    config EXAMPLE_MIPI_CSI_CAM_SENSOR_PWDN_PIN
        int "MIPI CSI Camera Sensor Power Down Pin"
        default -1
        range -1 56

    config EXAMPLE_H264_I_PERIOD
            int "H.264 Intra Frame period"
            default 30
            range 1 120
            help
                H.264 I-Frame period.

    config EXAMPLE_H264_BITRATE
        int "H.264 Bitrate"
        default 1000000
        range 25000 2500000
        help
            H.264 bitrate.

    config EXAMPLE_H264_MIN_QP
        int "H.264 Minimum Quality"
        default 25
        range 1 51
        help
            H.264 minimum quality, the value should be less than H.264 maximum quality.

    config EXAMPLE_H264_MAX_QP
        int "H.264 Maximum Quality"
        default 26
        range 1 51
        help
            H.264 maximum quality, the value should be larger than H.264 minimum quality.

    choice ESP_WIFI_SAE_MODE
        prompt "WPA3 SAE mode selection"
        default ESP_WPA3_SAE_PWE_BOTH
        help
            Select mode for SAE as Hunt and Peck, H2E or both.
        config ESP_WPA3_SAE_PWE_HUNT_AND_PECK
            bool "HUNT AND PECK"
        config ESP_WPA3_SAE_PWE_HASH_TO_ELEMENT
            bool "H2E"
        config ESP_WPA3_SAE_PWE_BOTH
            bool "BOTH"
    endchoice

    config ESP_WIFI_PW_ID
        string "PASSWORD IDENTIFIER"
        depends on  ESP_WPA3_SAE_PWE_HASH_TO_ELEMENT|| ESP_WPA3_SAE_PWE_BOTH
        default ""
        help
            password identifier for SAE H2E

    config ESP_MAXIMUM_RETRY
        int "Maximum retry"
        default 5
        help
            Set the Maximum retry to avoid station reconnecting to the AP unlimited when the AP is really inexistent.

    choice ESP_WIFI_SCAN_AUTH_MODE_THRESHOLD
        prompt "WiFi Scan auth mode threshold"
        default ESP_WIFI_AUTH_WPA2_PSK
        help
            The weakest authmode to accept in the scan mode.
            This value defaults to ESP_WIFI_AUTH_WPA2_PSK incase password is present and ESP_WIFI_AUTH_OPEN is used.
            Please select ESP_WIFI_AUTH_WEP/ESP_WIFI_AUTH_WPA_PSK incase AP is operating in WEP/WPA mode.

        config ESP_WIFI_AUTH_OPEN
            bool "OPEN"
        config ESP_WIFI_AUTH_WEP
            bool "WEP"
        config ESP_WIFI_AUTH_WPA_PSK
            bool "WPA PSK"
        config ESP_WIFI_AUTH_WPA2_PSK
            bool "WPA2 PSK"
        config ESP_WIFI_AUTH_WPA_WPA2_PSK
            bool "WPA/WPA2 PSK"
        config ESP_WIFI_AUTH_WPA3_PSK
            bool "WPA3 PSK"
        config ESP_WIFI_AUTH_WPA2_WPA3_PSK
            bool "WPA2/WPA3 PSK"
        config ESP_WIFI_AUTH_WAPI_PSK
            bool "WAPI PSK"
    endchoice

endmenu
```

## IDF_esp32p4_rtsp/sdkconfig.defaults
```kconfig
CONFIG_IDF_TARGET="esp32p4"
CONFIG_ESPTOOLPY_FLASHMODE_QIO=y
CONFIG_ESPTOOLPY_FLASHSIZE_16MB=y
CONFIG_PARTITION_TABLE_CUSTOM=y
CONFIG_SPIRAM=y

CONFIG_IDF_EXPERIMENTAL_FEATURES=y

CONFIG_SPIRAM_SPEED_200M=y

CONFIG_SLAVE_IDF_TARGET_ESP32C6=y
CONFIG_LWIP_TCPIP_RECVMBOX_SIZE=64
CONFIG_LWIP_TCP_SND_BUF_DEFAULT=65535
CONFIG_LWIP_TCP_WND_DEFAULT=65535
CONFIG_LWIP_TCP_RECVMBOX_SIZE=64
CONFIG_LWIP_MAX_SOCKETS=16

CONFIG_ESP_VIDEO_ENABLE_DVP_VIDEO_DEVICE=n
CONFIG_ESP_VIDEO_ENABLE_ISP_PIPELINE_CONTROLLER=y
CONFIG_ESP_VIDEO_ENABLE_HW_H264_VIDEO_DEVICE=y

CONFIG_FREERTOS_ENABLE_BACKWARD_COMPATIBILITY=y
CONFIG_FREERTOS_HZ=1000
CONFIG_FREERTOS_USE_TRACE_FACILITY=y
CONFIG_FREERTOS_USE_STATS_FORMATTING_FUNCTIONS=y
CONFIG_FREERTOS_VTASKLIST_INCLUDE_COREID=y
CONFIG_FREERTOS_GENERATE_RUN_TIME_STATS=y
CONFIG_FREERTOS_PLACE_FUNCTIONS_INTO_FLASH=y

CONFIG_CAMERA_OV5647=y
CONFIG_CAMERA_OV5647_AUTO_DETECT_MIPI_INTERFACE_SENSOR=y
CONFIG_CAMERA_OV5647_CSI_LINESYNC_ENABLE=y
CONFIG_CAMERA_OV5647_DEFAULT_IPA_JSON_CONFIGURATION_FILE=y
```

## IDF_esp32p4_webrtc/main/Kconfig
```kconfig
menu "DoorBell Local Demo"

config DOORBELL_WIFI_SSID
    string "Wi-Fi SSID"
    default "YOUR_WIFI_SSID"
    help
        Wi-Fi SSID used by station mode at boot.

config DOORBELL_WIFI_PASSWORD
    string "Wi-Fi password"
    default "YOUR_WIFI_PASSWORD"
    help
        Wi-Fi password used by station mode at boot.
        Set to empty for open networks.

choice DOORBELL_SIGNALING_MODE
    prompt "Signaling backend"
    default DOORBELL_SIGNALING_LOCAL_HTTP
    help
        Select signaling mode for WebRTC.

config DOORBELL_SIGNALING_LOCAL_HTTP
    bool "Local HTTPS signaling on ESP32 (/webrtc/signal)"

config DOORBELL_SIGNALING_JANUS
    bool "Remote Janus VideoRoom signaling"
endchoice

config DOORBELL_MQTT_BROKER_URI
    string "MQTT broker URI"
    default "mqtt://your-domain.example:1883"
    help
        MQTT broker URI for ESP32 telemetry/command channel.
        Example:
        mqtt://your-domain.example:1883

if DOORBELL_SIGNALING_JANUS
config DOORBELL_JANUS_SIGNAL_URL
    string "Janus API base URL"
    default "https://your-domain.example/janus"
    help
        Public Janus REST endpoint, for example:
        https://webrtc.example.com/janus

config DOORBELL_JANUS_ROOM_ID
    int "Janus VideoRoom ID"
    default 1234

config DOORBELL_JANUS_ROOM_PIN
    string "Janus room PIN (optional)"
    default ""

config DOORBELL_JANUS_DISPLAY
    string "Publisher display name"
    default "esp32-doorbell"

config DOORBELL_JANUS_TOKEN
    string "Janus token (optional)"
    default ""

config DOORBELL_JANUS_API_SECRET
    string "Janus API secret (optional)"
    default ""
endif
endmenu
```

## IDF_esp32p4_webrtc/sdkconfig.defaults.esp32p4
```kconfig
# Flash setting
CONFIG_FLASHMODE_QIO=y
CONFIG_ESPTOOLPY_FLASHSIZE_8MB=y

CONFIG_SPIRAM_SPEED_200M=y

# If you use serial JTAG turn on this option
#CONFIG_ESP_CONSOLE_USB_SERIAL_JTAG=y

# Use camera SC2336
CONFIG_CAMERA_OV5647=y

#
# Auto detect OV5647
#
CONFIG_CAMERA_OV5647_AUTO_DETECT_MIPI_INTERFACE_SENSOR=y
# end of Auto detect OV5647

# CONFIG_CAMERA_OV5647_MIPI_RAW8_800X1280_50FPS is not set
CONFIG_CAMERA_OV5647_MIPI_RAW8_800X640_50FPS=y
# CONFIG_CAMERA_OV5647_MIPI_RAW8_800X800_50FPS is not set
# CONFIG_CAMERA_OV5647_MIPI_RAW10_1920X1080_30FPS is not set
# CONFIG_CAMERA_OV5647_MIPI_RAW10_1280X960_BINNING_45FPS is not set
CONFIG_CAMERA_OV5647_MIPI_IF_FORMAT_INDEX_DEFAULT=1
CONFIG_CAMERA_OV5647_CSI_LINESYNC_ENABLE=y
# CONFIG_CAMERA_OV5647_ENABLE_MOTOR_BY_GPIO0 is not set
CONFIG_CAMERA_OV5647_DEFAULT_IPA_JSON_CONFIGURATION_FILE=y


# Enable ISP pipelines
CONFIG_ESP_VIDEO_ENABLE_ISP_PIPELINE_CONTROLLER=y

# Set Slave target type
CONFIG_IDF_SLAVE_TARGET="esp32c6"
CONFIG_SLAVE_IDF_TARGET_ESP32C6=y

# Enable following configuration if support C5 Slave, make sure GPIO matched
# CONFIG_SLAVE_IDF_TARGET_ESP32C5=y
# CONFIG_ESP_HOSTED_SPI_HD_HOST_INTERFACE=y
# CONFIG_ESP_SPI_HD_GPIO_CS=4
# CONFIG_ESP_SPI_HD_GPIO_CLK=5
# CONFIG_ESP_SPI_HD_GPIO_D0=20
# CONFIG_ESP_SPI_HD_GPIO_D1=21
# CONFIG_ESP_SPI_HD_GPIO_D2=22
# CONFIG_ESP_SPI_HD_GPIO_D3=23
# CONFIG_ESP_SPI_HD_GPIO_DATA_READY=32
# CONFIG_ESP_SPI_HD_GPIO_RESET_SLAVE=33
# CONFIG_ESP_SPI_HD_FREQ_ESP32XX=40
# CONFIG_ESP_HOSTED_SPI_HD_PRIV_INTERFACE_4_DATA_LINES=y
```
